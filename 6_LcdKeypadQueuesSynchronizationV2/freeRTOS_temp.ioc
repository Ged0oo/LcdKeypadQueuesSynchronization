# file: freeRTOS_temp.ioc
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FREERTOS.BinarySemaphores01=KeypadLcdSemaphore,Dynamic,NULL
FREERTOS.Queues01=NumbersQueue,5,uint8_t,0,Dynamic,NULL,NULL;CharactersQueue,5,uint8_t,0,Dynamic,NULL,NULL
FREERTOS.Tasks01=task1,24,128,vLcdTask,Default,NULL,Dynamic,NULL,NULL;task2,40,128,vKeypadTask,Default,NULL,Dynamic,NULL,NULL
Mcu.Family=STM32F1
Mcu.Name=STM32F103C(8-B)Tx
Mcu.Package=LQFP48
NVIC.PriorityGroup=NVIC_PRIORITYGROUP_4
PD0-OSC_IN.Mode=HSE-External-Oscillator
PD0-OSC_IN.Signal=RCC_OSC_IN
PD1-OSC_OUT.Mode=HSE-External-Oscillator
PD1-OSC_OUT.Signal=RCC_OSC_OUT
ProjectManager.HeapSize=0x200
ProjectManager.StackSize=0x400
ProjectManager.TargetToolchain=STM32CubeIDE
RCC.AHBCLKDivider=RCC_SYSCLK_DIV2
RCC.AHBFreq_Value=8000000
RCC.APB1CLKDivider=RCC_HCLK_DIV4
RCC.APB1Freq_Value=2000000
RCC.APB1TimFreq_Value=4000000
RCC.APB2Freq_Value=8000000
RCC.APB2TimFreq_Value=8000000
RCC.HCLKFreq_Value=8000000
RCC.PLLSourceVirtual=RCC_PLLSOURCE_HSE
RCC.SYSCLKFreq_VALUE=16000000
RCC.SYSCLKSource=RCC_SYSCLKSOURCE_PLLCLK
RCC.USBFreq_Value=16000000
VP_FREERTOS_VS_CMSIS_V2.Mode=CMSIS_V2
board=custom

// file: Core/Src/main.c
/* USER CODE BEGIN Header */
/**
  ******************************************************************************
  * @file           : main.c
  * @brief          : Main program body
  ******************************************************************************
  * @attention
  *
  * Copyright (c) 2023 STMicroelectronics.
  * All rights reserved.
  *
  * This software is licensed under terms that can be found in the LICENSE file
  * in the root directory of this software component.
  * If no LICENSE file comes with this software, it is provided AS-IS.
  *
  ******************************************************************************
  */
/* USER CODE END Header */
#include "main.h"
#include "cmsis_os.h"
#include "gpio.h"

/* USER CODE BEGIN PV */

GPIO_ConfigType DecrementButton = {.GPIOx=GPIOA, .GPIO_PinNumber=GPIO_PIN_8  , .GPIO_PinMode=GPIO_IN};
GPIO_ConfigType ChoiceButton = {.GPIOx=GPIOB, .GPIO_PinNumber=GPIO_PIN_3 , .GPIO_PinMode=GPIO_IN};
GPIO_ConfigType IncrementButton = {.GPIOx=GPIOB, .GPIO_PinNumber=GPIO_PIN_9 , .GPIO_PinMode=GPIO_IN};

/* USER CODE END PV */

void SystemClock_Config(void);
void MX_FREERTOS_Init(void);

int main(void)
{

  /* MCU Configuration--------------------------------------------------------*/

  /* Reset of all peripherals, Initializes the Flash interface and the Systick. */
  HAL_Init();

  /* USER CODE BEGIN Init */

	MRCC_voidClockInit(&RCC_obj);
	MRCC_voidPeripheralClockEnable(RCC_APB2_BUS , RCC_GPIOA_CLOCK);
	MRCC_voidPeripheralClockEnable(RCC_APB2_BUS , RCC_GPIOB_CLOCK);

	lcd_4bit_intialize(&lcd_1);
	keypad_initialize(&keypad_1);

	lcd_4bit_send_string_pos(&lcd_1, 1, 1, "Direction => ");
	lcd_4bit_send_string_pos(&lcd_1, 2, 1, "Character => ");

	MGPIO_voidInitPortPin(&DecrementButton);
	MGPIO_voidInitPortPin(&ChoiceButton);
	MGPIO_voidInitPortPin(&IncrementButton);

  /* USER CODE END Init */

  /* Configure the system clock */
  SystemClock_Config();

  /* Initialize all configured peripherals */
  MX_GPIO_Init();

  /* Init scheduler */
  osKernelInitialize();  /* Call init function for freertos objects (in freertos.c) */
  MX_FREERTOS_Init();

  /* Start scheduler */
  osKernelStart();

  /* We should never get here as control is now taken by the scheduler */
  /* Infinite loop */
  while (1)
  {

  }
}

void SystemClock_Config(void)
{
  RCC_OscInitTypeDef RCC_OscInitStruct = {0};
  RCC_ClkInitTypeDef RCC_ClkInitStruct = {0};

  /** Initializes the RCC Oscillators according to the specified parameters
  * in the RCC_OscInitTypeDef structure.
  */
  RCC_OscInitStruct.OscillatorType = RCC_OSCILLATORTYPE_HSE;
  RCC_OscInitStruct.HSEState = RCC_HSE_ON;
  RCC_OscInitStruct.HSEPredivValue = RCC_HSE_PREDIV_DIV1;
  RCC_OscInitStruct.HSIState = RCC_HSI_ON;
  RCC_OscInitStruct.PLL.PLLState = RCC_PLL_ON;
  RCC_OscInitStruct.PLL.PLLSource = RCC_PLLSOURCE_HSE;
  RCC_OscInitStruct.PLL.PLLMUL = RCC_PLL_MUL2;
  if (HAL_RCC_OscConfig(&RCC_OscInitStruct) != HAL_OK)
  {
    Error_Handler();
  }

  /** Initializes the CPU, AHB and APB buses clocks
  */
  RCC_ClkInitStruct.ClockType = RCC_CLOCKTYPE_HCLK|RCC_CLOCKTYPE_SYSCLK
                              |RCC_CLOCKTYPE_PCLK1|RCC_CLOCKTYPE_PCLK2;
  RCC_ClkInitStruct.SYSCLKSource = RCC_SYSCLKSOURCE_PLLCLK;
  RCC_ClkInitStruct.AHBCLKDivider = RCC_SYSCLK_DIV2;
  RCC_ClkInitStruct.APB1CLKDivider = RCC_HCLK_DIV4;
  RCC_ClkInitStruct.APB2CLKDivider = RCC_HCLK_DIV1;

  if (HAL_RCC_ClockConfig(&RCC_ClkInitStruct, FLASH_LATENCY_0) != HAL_OK)
  {
    Error_Handler();
  }
}

void Error_Handler(void)
{
  __disable_irq();
  while (1)
  {
  }
}

// file: Core/Src/freertos.c
/* USER CODE BEGIN Header */
/**
  ******************************************************************************
  * File Name          : freertos.c
  * Description        : Code for freertos applications
  ******************************************************************************
  * @attention
  *
  * Copyright (c) 2023 STMicroelectronics.
  * All rights reserved.
  *
  * This software is licensed under terms that can be found in the LICENSE file
  * in the root directory of this software component.
  * If no LICENSE file comes with this software, it is provided AS-IS.
  *
  ******************************************************************************
  */
/* USER CODE END Header */

#include "FreeRTOS.h"
#include "task.h"
#include "main.h"
#include "cmsis_os.h"

/* USER CODE BEGIN Includes */
#include "LCD_interface.h"
#include "KEYPAD_interface.h"
#include "queue.h"

/* USER CODE END Includes */

/* USER CODE BEGIN PD */

#define NUMBERS_DATA    	0
#define CHARACTERS_DATA 	1

/* USER CODE END PD */

/* USER CODE BEGIN Variables */

uint8_t CurrentData;
uint8_t keypadVal = NOTPRESSED;

/* USER CODE END Variables */
/* Definitions for task1 */
osThreadId_t task1Handle;
const osThreadAttr_t task1_attributes = {
  .name = "task1",
  .stack_size = 128 * 4,
  .priority = (osPriority_t) osPriorityNormal,
};
/* Definitions for task2 */
osThreadId_t task2Handle;
const osThreadAttr_t task2_attributes = {
  .name = "task2",
  .stack_size = 128 * 4,
  .priority = (osPriority_t) osPriorityHigh,
};
/* Definitions for NumbersQueue */
osMessageQueueId_t NumbersQueueHandle;
const osMessageQueueAttr_t NumbersQueue_attributes = {
  .name = "NumbersQueue"
};
/* Definitions for CharactersQueue */
osMessageQueueId_t CharactersQueueHandle;
const osMessageQueueAttr_t CharactersQueue_attributes = {
  .name = "CharactersQueue"
};
/* Definitions for KeypadLcdSemaphore */
osSemaphoreId_t KeypadLcdSemaphoreHandle;
const osSemaphoreAttr_t KeypadLcdSemaphore_attributes = {
  .name = "KeypadLcdSemaphore"
};

void vLcdTask(void *argument);
void vKeypadTask(void *argument);

void MX_FREERTOS_Init(void); /* (MISRA C 2004 rule 8.1) */

void MX_FREERTOS_Init(void) {

  /* Create the semaphores(s) */
  /* creation of KeypadLcdSemaphore */
  KeypadLcdSemaphoreHandle = osSemaphoreNew(1, 0, &KeypadLcdSemaphore_attributes);

  /* Create the queue(s) */
  /* creation of NumbersQueue */
  NumbersQueueHandle = osMessageQueueNew (5, sizeof(uint8_t), &NumbersQueue_attributes);

  /* creation of CharactersQueue */
  CharactersQueueHandle = osMessageQueueNew (5, sizeof(uint8_t), &CharactersQueue_attributes);

  /* Create the thread(s) */
  /* creation of task1 */
  task1Handle = osThreadNew(vLcdTask, NULL, &task1_attributes);

  /* creation of task2 */
  task2Handle = osThreadNew(vKeypadTask, NULL, &task2_attributes);

}

void vLcdTask(void *argument)
{
  /* USER CODE BEGIN vLcdTask */
	BaseType_t RetVal = pdTRUE;
	uint8_t message = 0;
	/* Infinite loop */
	for(;;)
	{
		switch(CurrentData)
		{
			case CHARACTERS_DATA:
				RetVal= xQueueReceive(CharactersQueueHandle, &message, HAL_MAX_DELAY);
				lcd_4bit_send_char_data_pos(&lcd_1, 2, 14, message);
				break;

			case NUMBERS_DATA:
				RetVal= xQueueReceive(NumbersQueueHandle, &message, HAL_MAX_DELAY);
				lcd_4bit_send_char_data_pos(&lcd_1, 1, 14, message);
				break;
		}
		osSemaphoreRelease(KeypadLcdSemaphoreHandle);
	}
  /* USER CODE END vLcdTask */
}

void vKeypadTask(void *argument)
{
  /* USER CODE BEGIN vKeypadTask */
	BaseType_t RetVal = pdTRUE;
	/* Infinite loop */
	for(;;)
	{
		keypadVal = NOTPRESSED;
		keypadVal = read_keypad(&keypad_1);
		if(keypadVal != NOTPRESSED)
		{
			if(keypadVal<'1' || keypadVal>'9')
			{
				CurrentData = CHARACTERS_DATA;
				RetVal = xQueueSendToFront(CharactersQueueHandle, (void *)&keypadVal, HAL_MAX_DELAY);
			}
			else
			{
				CurrentData = NUMBERS_DATA;
				RetVal = xQueueSendToFront(NumbersQueueHandle, (void *)&keypadVal, HAL_MAX_DELAY);
			}

			osSemaphoreAcquire(KeypadLcdSemaphoreHandle, HAL_MAX_DELAY);
		}
	}
  /* USER CODE END vKeypadTask */
}

/* USER CODE BEGIN Application */

/* Task to be created. */

/* USER CODE END Application */
